## sdkconfig.defaults
```kconfig
# Minimal ESP32-S3 config
CONFIG_IDF_TARGET="esp32s3"
CONFIG_ESP_MAIN_TASK_STACK_SIZE=4096
CONFIG_FREERTOS_HZ=1000

# The host connects via the on-board CH340 USB-to-UART bridge, so "USB" on this
# board is really UART0 at the ESP32's end. We own UART0 exclusively for the
# binary protocol — no console, no logs, no boot spew. ESP_LOG calls become
# no-ops at runtime, ensuring nothing can ever corrupt the framed stream.
CONFIG_ESP_CONSOLE_NONE=y
# CONFIG_ESP_CONSOLE_UART_DEFAULT is not set
# CONFIG_ESP_CONSOLE_UART_CUSTOM is not set
# CONFIG_ESP_CONSOLE_USB_CDC is not set
# CONFIG_ESP_CONSOLE_USB_SERIAL_JTAG is not set
CONFIG_ESP_CONSOLE_SECONDARY_NONE=y
# CONFIG_ESP_CONSOLE_SECONDARY_USB_SERIAL_JTAG is not set

# Silence the bootloader over UART0 at boot — otherwise the host sees a short
# burst of ASCII before the first protocol frame (the Python parser would
# discard it via COBS resync, but better to be tidy).
CONFIG_BOOTLOADER_LOG_LEVEL_NONE=y
CONFIG_BOOTLOADER_LOG_LEVEL=0

# Compile-out application-level logs. ESP_LOGI/W/E become no-ops.
CONFIG_LOG_DEFAULT_LEVEL_NONE=y
CONFIG_LOG_DEFAULT_LEVEL=0
CONFIG_LOG_MAXIMUM_LEVEL=0
```
